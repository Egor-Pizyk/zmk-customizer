## tests/fixtures/generated/unibody/Kconfig.defconfig
```kconfig
if SHIELD_UNIBODY_SIX

config ZMK_KEYBOARD_NAME
    default "Unibody six"

endif
```

## tests/fixtures/wiring/matrix-row2col/Kconfig.defconfig
```kconfig
if SHIELD_WIRING_SAMPLE

config ZMK_KEYBOARD_NAME
    default "Wiring sample"

endif
```

## tests/fixtures/wiring/split-matrix/Kconfig.defconfig
```kconfig
if SHIELD_WIRING_SAMPLE_LEFT

config ZMK_KEYBOARD_NAME
    default "Wiring sample"

config ZMK_SPLIT_ROLE_CENTRAL
    default y

endif

if SHIELD_WIRING_SAMPLE_LEFT || SHIELD_WIRING_SAMPLE_RIGHT

config ZMK_SPLIT
    default y

endif
```

## tests/fixtures/wiring/split-matrix/Kconfig.shield
```kconfig
config SHIELD_WIRING_SAMPLE_LEFT
    def_bool $(shields_list_contains,wiring_sample_left)

config SHIELD_WIRING_SAMPLE_RIGHT
    def_bool $(shields_list_contains,wiring_sample_right)
```
