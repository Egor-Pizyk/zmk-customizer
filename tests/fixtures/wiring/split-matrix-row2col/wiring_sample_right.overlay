#include "wiring_sample.dtsi"

&kscan0 {
    row-gpios = <&pro_micro 0 GPIO_ACTIVE_HIGH>;
    col-gpios = <&pro_micro 1 (GPIO_ACTIVE_HIGH | GPIO_PULL_DOWN)>;
};

&default_transform {
    col-offset = <2>;
};
